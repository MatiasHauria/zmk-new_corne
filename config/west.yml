## config/west.yml
```yaml
manifest:
  remotes:
    - name: zmkfirmware
      url-base: https://github.com/zmkfirmware

    # 👇 AGREGAR ESTO
    - name: dsifry
      url-base: https://github.com/dsifry

  projects:
    - name: eyelash_corne
      url: https://github.com/a741725193/zmk-new_corne
      revision: main

    - name: zmk
      remote: zmkfirmware
      revision: v0.3.0
      import: app/west.yml

    # 👇 AGREGAR ESTO
    - name: nice-view-mod
      remote: dsifry
      revision: main

  self:
    path: config
```
